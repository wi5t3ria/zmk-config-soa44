## Kconfig
```kconfig
# Copyright (c) 2020 The ZMK Contributors
# SPDX-License-Identifier: MIT

config SOA44_BATTERY_VOLTAGE_DIVIDER
    bool "SOA44 Battery voltage divider"
    depends on ADC
    depends on ZMK_BATTERY
    default $(dt_has_compat,soa44$(comma)battery-voltage-divider)
    help
      Custom battery voltage divider driver with mv-to-pct-thresholds support
```

## boards/shields/soa44/Kconfig.defconfig
```kconfig
if SHIELD_SOA44_R

config ZMK_KEYBOARD_NAME
    default "soa44_R"

config ZMK_SPLIT
    default y

config ZMK_SPLIT_ROLE_CENTRAL
    default y

endif

if SHIELD_SOA44_L

config ZMK_KEYBOARD_NAME
    default "soa44_L"

config ZMK_SPLIT
    default y

endif
```

## config/west.yml
```yaml
manifest:
  remotes:
    - name: zmkfirmware
      url-base: https://github.com/zmkfirmware
    - name: gohanda11
      url-base: https://github.com/gohanda11
  projects:
    - name: zmk
      remote: zmkfirmware
      revision: main
      import: app/west.yml
    - name: zmk-pmw3610-driver
      remote: gohanda11
      revision: main
  self:
    path: config
```

## dts/bindings/sensor/zmk,battery-voltage-divider.yaml
```yaml
description: ZMK battery voltage divider sensor with custom thresholds

compatible: "zmk,battery-voltage-divider"

properties:
  io-channels:
    type: phandle-array
    required: true
    description: ADC IO channel to use for battery voltage measurement
    
  power-gpios:
    type: phandle-array
    description: GPIO to enable/disable the voltage divider power
    
  output-ohms:
    type: int
    required: true
    description: Output resistance of the voltage divider in ohms
    
  full-ohms:
    type: int
    required: true
    description: Full resistance of the voltage divider in ohms
    
  mv-to-pct-thresholds:
    type: array
    description: |
      Array of millivolt thresholds for battery percentage calculation.
      Values should be in descending order (highest voltage first).
      Each value corresponds to a percentage from 100% down to 0%.
      Example: <1400 1350 1300 1250 1200 1150 1100> creates 6 steps:
      1400mV=100%, 1350mV=83%, 1300mV=67%, 1250mV=50%, 1200mV=33%, 1150mV=17%, 1100mV=0%
```
